VERSION ""

NS_ :

BS_:

BU_:
VAL_TABLE_ StateValueTable 20658 "STOPPED" 20657 "STARTED" ;
VAL_TABLE_ CmdValueTable 20642 "STOP" 20641 "START" ;

BO_ 11 ResponseMsg: 2 Vector__XXX
 SG_ StateVal : 7|16@0+ (1,0) [0|0] "" Vector__XXX

BO_ 10 CmdMsg: 2 Vector__XXX
 SG_ CmdVal : 7|16@0+ (1,0) [0|0] "" Vector__XXX

BA_DEF_  "BusType" STRING ;
BA_DEF_DEF_  "BusType" "CAN";
VAL_ 11 StateVal 20658 "STOPPED" 20657 "STARTED" ;
VAL_ 10 CmdVal 20642 "STOP" 20641 "START" ;
